#include "main.h"
#include "FreeRTOS.h"
#include "task.h"
#include "queue.h"
#include "semphr.h"
#include "tsl2591.h"

/* ── ARCHITECTURE SYSTEM PROTOTYPES ────────────────────────────────────── */
void SystemClock_Config(void);
void MX_GPIO_Init(void);
void MX_I2C1_Init(void);
void Error_Handler(void);
/* ── RUNTIME GLOBAL ALLOCATIONS ────────────────────────────────────────── */
I2C_HandleTypeDef       hi2c1;
DMA_HandleTypeDef  hdma_i2c1_rx;
static TSL2591_Handle_t g_lightDrv;

/* Live tracking inspection container for your Live Expressions frame */
volatile uint16_t       LiveLightReading = 0;

/* ── OS ENGINE SYNC HANDLES ────────────────────────────────────────────── */
static QueueHandle_t    xLightQueue = NULL;
static SemaphoreHandle_t xI2CMutex   = NULL;

/* ── TASK 1: INDUSTRIAL SENSOR DRIVER CADENCE THREAD ───────────────────── */
static void vLightSensorDriverTask(void *pvParameters)
{
    (void)pvParameters;
    TSL2591_Handle_t *drv = &g_lightDrv;
    LightSensorMsg_t  msg;
    TSL2591_Status_t  status;

    /* Chip configurations initialize safely inside our running kernel frame */
    if (TSL2591_Driver_Init(drv, &hi2c1, TSL2591_I2C_ADDR) != TSL2591_OK)
    {
        vTaskSuspend(NULL); /* Freeze this parsing sequence safely on failure */
    }

    for (;;)
    {
        /* Safe protection for multi-device configurations sharing the same physical bus */
        if (xSemaphoreTake(xI2CMutex, pdMS_TO_TICKS(50)) == pdTRUE)
        {
            status = TSL2591_Driver_ReadLight(drv, &msg.raw);
            xSemaphoreGive(xI2CMutex);

            if (status == TSL2591_OK)
            {
                msg.timestamp = xTaskGetTickCount();
                xQueueSend(xLightQueue, &msg, 0); /* Non-blocking enqueue */
            }
        }
        vTaskDelay(pdMS_TO_TICKS(SENSOR_POLL_MS));
    }
}

/* ── TASK 2: APPLICATION BUSINESS THREAD ────────────────────────────────── */
static void vLightSensorAppTask(void *pvParameters)
{
    (void)pvParameters;
    LightSensorMsg_t msg;

    for (;;)
    {
        /* Sleep block indefinitely until driver task unblocks the queue stream */
        if (xQueueReceive(xLightQueue, &msg, portMAX_DELAY) == pdTRUE)
        {
            LiveLightReading = msg.raw; /* Export calculation directly into RAM view */

            if (msg.raw > LIGHT_THRESHOLD)
                HAL_GPIO_WritePin(GPIOD, GPIO_PIN_12, GPIO_PIN_SET);   /* Trigger LED */
            else
                HAL_GPIO_WritePin(GPIOD, GPIO_PIN_12, GPIO_PIN_RESET); /* Kill LED */
        }
    }
}

/* ── SYSTEM APPLICATION ENTRY POINT ────────────────────────────────────── */
int main(void)
{
    HAL_Init();
    SystemClock_Config();
    MX_GPIO_Init();
    MX_I2C1_Init();

    /* Instantiating core peripheral driver configurations */
    g_lightDrv.hi2c        = &hi2c1;
    g_lightDrv.devAddr     = TSL2591_I2C_ADDR;
    g_lightDrv.initialized = 0;

    /* Initialize Sync Primitives */
    xLightQueue = xQueueCreate(4, sizeof(LightSensorMsg_t));
    xI2CMutex   = xSemaphoreCreateMutex();

    configASSERT(xLightQueue != NULL);
    configASSERT(xI2CMutex   != NULL);

    /* Allocate OS Threads */
    xTaskCreate(vLightSensorDriverTask, "LightDrv", 256, NULL, tskIDLE_PRIORITY + 2, NULL);
    xTaskCreate(vLightSensorAppTask,    "LightApp", 128, NULL, tskIDLE_PRIORITY + 1, NULL);

    /* Hand control over to FreeRTOS Kernel Scheduler */
    vTaskStartScheduler();

    while (1) {}
}

/* ── HARDWARE GENERATED BLOCKS (CubeMX Fallback Containers) ───────────── */
void SystemClock_Config(void)
{
    /* Keep the system clock initialization logic generated by your CubeMX here */
}

void MX_I2C1_Init(void)
{
    hi2c1.Instance             = I2C1;
    hi2c1.Init.ClockSpeed      = 100000;
    hi2c1.Init.DutyCycle       = I2C_DUTYCYCLE_2;
    hi2c1.Init.OwnAddress1     = 0;
    hi2c1.Init.AddressingMode  = I2C_ADDRESSINGMODE_7BIT;
    hi2c1.Init.DualAddressMode = I2C_DUALADDRESS_DISABLE;
    hi2c1.Init.OwnAddress2     = 0;
    hi2c1.Init.GeneralCallMode = I2C_GENERALCALL_DISABLE;
    hi2c1.Init.NoStretchMode   = I2C_NOSTRETCH_DISABLE;
    if (HAL_I2C_Init(&hi2c1) != HAL_OK)
    {
        while(1);
    }
}

void MX_GPIO_Init(void)
{
    GPIO_InitTypeDef GPIO_InitStruct = {0};

    __HAL_RCC_GPIOD_CLK_ENABLE();
    __HAL_RCC_GPIOB_CLK_ENABLE();

    GPIO_InitStruct.Pin   = GPIO_PIN_12;
    GPIO_InitStruct.Mode  = GPIO_MODE_OUTPUT_PP;
    GPIO_InitStruct.Pull  = GPIO_NOPULL;
    GPIO_InitStruct.Speed = GPIO_SPEED_FREQ_LOW;
    HAL_GPIO_Init(GPIOD, &GPIO_InitStruct);
}

void Error_Handler(void)
{
  __disable_irq();

  while (1)
  {
  }
}
